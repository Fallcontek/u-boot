## board/solidrun/imx8mp_solidrun/Kconfig
```kconfig
if TARGET_IMX8MP_SOLIDRUN

config SYS_BOARD
	default "imx8mp_solidrun"

config SYS_VENDOR
	default "solidrun"

config SYS_CONFIG_NAME
	default "imx8mp_solidrun"

source "board/freescale/common/Kconfig"

endif
```
